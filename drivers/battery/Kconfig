## drivers/staging/nanohub/Kconfig
```kconfig
config NANOHUB
	tristate "Nanohub"
	default N
	select IIO
	select CONTEXTHUB_DRV
	help
	  Enable support for the nanohub sensorhub driver.

	  This driver supports the android nanohub sensorhub.

	  If in doubt, say N here.

if NANOHUB

config NANOHUB_SPI
	bool "Nanohub SPI"
	default N
	help
	  Enable nanohub SPI support.

	  Either this or NANOHUB_I2C should be selected.

	  If in doubt, say Y here.

config NANOHUB_I2C
	bool "Nanohub I2C"
	default N
	help
	  Enable nanohub I2C support.

	  Either this or NANOHUB_SPI should be selected.

	  If in doubt, say N here.

config NANOHUB_MAILBOX
	bool "Nanohub Mailbox"
	default Y
	help
	  Enable nanohub Mailbox support.

	  Either this or NANOHUB_MAILBOX should be selected.

	  If in doubt, say N here.

config CONTEXTHUB_DRV
	bool "Contexthub driver"
	default Y
	help
	  Enable contexthub driver

config SENSOR_DRV
	bool "Sensor driver to support exynos sensor Hal"
	default N
	help
	  Enable sensorhub hal support.

config CONTEXTHUB_DEBUG
	bool "Nanohub debug"
	default N
	help
	  Enable nanohub device debug message

config CONTEXTHUB_SENSOR_DEBUG
	bool "Nanohub sensor debug"
	default N
	help
	  Enable nanohub seneor alive check

config SENSORS_SSP_HRM_ADI
	tristate "ADI HRM sensor support"
	default N
	help
	  Support ADI HRM sensor.

config SENSORS_SSP_DEBUG
	bool "ssp sensor debug"
	default N
	help
	  Enable ssp sensor debug message
endif # NANOHUB

#
# sensor drivers configuration
#
config SENSORS_SYSFS
	tristate "Sensors sysfs"
	default n
	help
	  Support sysfs for sensors.
          If you say yes here you get sysfs support for
	  sensor factory test.
	  To compile this driver as a module, choose M here: the
	  module will be called sensors_core.

config SENSORS_SSP
	tristate "Sensors ssp"
	default n
	depends on SPI
	help
	  ssp driver for sensor hub.
          If you say yes here you get ssp support for
	  sensor hub.
	  To compile this driver as a module, choose M here: the
	  module will be called ssp.

config SENSORS_SSP_CHUB
	tristate "Sensors ssp chub"
	default n
	depends on SPI
	help
	  ssp driver for sensor hub.
          If you say yes here you get ssp support for
	  sensor hub.
	  To compile this driver as a module, choose M here: the
	  module will be called ssp.

config SENSORS_SSP_FRESH6
	tristate "FRESH6 Project"
	default n
	depends on SPI
	help
	  Binary file for ssp driver.
          If you say yes here you get FRESH6 project support for
	  factory test.
	  To compile this driver as a module, choose M here: the
	  module will be called ssp.

config SENSORS_SSP_WISE6
	tristate "WISE6 Project"
	default n
	depends on SPI
	help
	  Binary file for ssp driver.
          If you say yes here you get WISE6 project support for
	  factory test.
	  To compile this driver as a module, choose M here: the
	  module will be called ssp.	  

config SENSORS_SSP_LUCKY
	tristate "Lucky Project"
	default n
	help
	  Binary file for ssp driver.
          If you say yes here you get Lucky project support for
	  factory test.
	  To compile this driver as a module, choose M here: the
	  module will be called ssp.

config SENSORS_SSP_SENSORHUB
	tristate "Sensors ssp sensorhub"
	default n
	depends on SPI
	help
	  ssp sensor hub driver for sensor hub.
          If you say yes here you get ssp support for
	  sensor hub.
	  To compile this driver as a module, choose M here: the
	  module will be called ssp.

config SENSORS_SSP_FACTORY
	tristate "ssp factory"
	depends on SENSORS_SSP
	default n
	help
	  ssp sensor hub driver for factory test.
          If you say yes here you can enable fatory drvier for
	  factory test.
	  To compile this driver as a module, choose M here: the
	  module will be called ssp.

config SENSORS_SSP_ACCELEROMETER_SENSOR
	tristate "Sensors ssp acceleromter sensor"
	default n
	depends on SPI
	help
          If you say yes here, accelererometer sensor supported
	  To compile this driver as a module, choose M here: the
	  module will be called ssp.

config SENSORS_SSP_ACCELEROMETER_32GSENSOR
	tristate "Sensors ssp acceleromter 32g sensor"
	default n
	depends on SPI
	help
          Sensors ssp acceleromter 32g sensor.

config SENSORS_SSP_LINEAR_ACCELEROMETER_SENSOR
	tristate "Sensors ssp linear acceleromter sensor"
	default n
	depends on SPI
	help
          Sensors ssp linear acceleromter sensor.

config SENSORS_SSP_GYRO_SENSOR
	tristate "Sensors ssp gyro sensor"
	default n
	depends on SPI
	help
          If you say yes here, gyro sensor supported
	  To compile this driver as a module, choose M here: the
	  module will be called ssp.

config SENSORS_SSP_MAGNETIC_SENSOR
	tristate "Sensors ssp magnetic sensor"
	default n
	depends on SPI
	help
          If you say yes here, magnetic sensor supported
	  To compile this driver as a module, choose M here: the
	  module will be called ssp.

config SENSORS_SSP_PRESSURE_SENSOR
	tristate "Sensors ssp pressure sensor"
	default n
	depends on SPI
	help
          If you say yes here, pressure sensor supported
	  To compile this driver as a module, choose M here: the
	  module will be called ssp.

config SENSORS_SSP_LIGHT_SENSOR
	tristate "Sensors ssp light sensor"
	default n
	depends on SPI
	help
          If you say yes here, light sensor supported
	  To compile this driver as a module, choose M here: the
	  module will be called ssp.

config SENSORS_SSP_OPT3007
	tristate "Sensors ssp OPT3007"
	default n
	depends on SPI
	help
          If you say yes here, light sensor supported
	  To compile this driver as a module, choose M here: the
	  module will be called ssp.

config SENSORS_SSP_TEMP_HUMID_SENSOR
	tristate "Sensors ssp temp_humid sensor"
	default n
	depends on SPI
	help
          If you say yes here, temp_humid sensor supported
	  To compile this driver as a module, choose M here: the
	  module will be called ssp.
config SENSORS_SSP_SKIN_TEMP
	tristate "Sensors ssp skin temp sensor"
	depends on SPI
	help
	  If you say yes here, skin temp sensor supported
	  Two temp sensor will be working
config SENSORS_SSP_ROT_VECTOR_SENSOR
	tristate "Sensors ssp rotation vector sensor"
	default n
	depends on SPI
	help
          If you say yes here, rotation vector sensor supported
	  To compile this driver as a module, choose M here: the
	  module will be called ssp.

config SENSORS_ECG_LIB
	tristate "Sensors ssp ecg lib"
	default n
	depends on SPI
	help
          Sensors ssp ecg lib

config SENSORS_SSP_BIA_SENSOR
	tristate "Sensors ssp bia"
	default n
	depends on SPI
	help
          Sensors ssp bia

config SENSORS_SSP_HRM_SENSOR
	tristate "Sensors ssp hrm sensor"
	default n
	depends on SPI
	help
          If you say yes here, hrm sensor supported
	  To compile this driver as a module, choose M here: the
	  module will be called ssp.

config SENSORS_SSP_HRM_ECG_SENSOR
	tristate "Sensors ssp ecg hrm sensor"
	default n
	depends on SPI
	help
          If you say yes here, hrm sensor supported
	  To compile this driver as a module, choose M here: the
	  module will be called ssp.

config SENSORS_SSP_UV_SENSOR
	tristate "Sensors ssp uv sensor"
	default n
	depends on SPI
	help
          If you say yes here, uv sensor supported
	  To compile this driver as a module, choose M here: the
	  module will be called ssp.

config SENSORS_SSP_FRONT_HRM_SENSOR
	tristate "Sensors ssp front hrm sensor"
	default n
	depends on SPI
	help
          If you say yes here, front hrm sensor supported
	  To compile this driver as a module, choose M here: the
	  module will be called ssp.

config SENSORS_SSP_GSR_SENSOR
	tristate "Sensors ssp gsr sensor"
	default n
	depends on SPI
	help
          If you say yes here, gsr sensor supported
	  To compile this driver as a module, choose M here: the
	  module will be called ssp.

config SENSORS_SSP_ECG_SENSOR
	tristate "Sensors ssp ecg sensor"
	default n
	depends on SPI
	help
          If you say yes here, ecg sensor supported
	  To compile this driver as a module, choose M here: the
	  module will be called ssp.

config SENSORS_SSP_GRIP_SENSOR
	tristate "Sensors ssp grip sensor"
	default n
	depends on SPI
	help
          If you say yes here, grip sensor supported
	  To compile this driver as a module, choose M here: the
	  module will be called ssp.

config SENSORS_SSP_LPM_MOTION
	tristate "Sensors ssp lpm motion"
	default n
	depends on SPI
	help
          If you say yes here, lpm motion supported
	  To compile this driver as a module, choose M here: the
	  module will be called ssp.

config SENSORS_SSP_HALLIC_SENSOR
	tristate "Sensors ssp hall ic sensor"
	default n
	depends on SPI
	help
          If you say yes here, hall ic sensor supported
	  To compile this driver as a module, choose M here: the
	  module will be called ssp.

config SENSORS_SSP_INPUT_DEV
	tristate "Sensors input device"
	default n
	help
	  Support input device.

config SENSORS_SSP_VIB_NOTIFY
	tristate "Sensors vibrator notifier"
	default n
	help
	  Support vibrator notifier.

config SENSORS_SSP_AP_WAKEUP
	tristate "Sensors ap wakeup support"
	default n
	help
	  Support ap wakeup.

config SENSORS_SSP_HRM_ADI
	tristate "Sensors ADI HRM sensor support"
	default n
	help
	  Support ADI HRM sensor.

config SENSORS_SSP_THERMISTOR_SENSOR
	tristate "Sensors ssp thermistor sensor"
	default n
	depends on SPI
	help
          If you say yes here, thermistor sensor supported
	  To compile this driver as a module, choose M here: the
	  module will be called ssp.

config SENSORS_SSP_TEMPERATURE_SENSOR
	tristate "Sensors ssp temperature sensor"
	default n
	depends on SPI
	help
          Sensors ssp temperature lib
          
config SENSORS_SSP_MAGNETIC_32BIT
	tristate "Sensors ssp magnetic 32bit"
	default n
	depends on SPI
	help
          Sensors ssp magnetic 32bit

config SENSORS_SSP_DEBUG
	tristate "Sensors ssp debug"
	default n
	depends on SPI
	help
          If you say yes here, ssp debug supported

config SENSORS_SSP_BIGDATA_V2
	tristate "Sensors big data v2"
	default n
	depends on SPI
	help
          Sensors big data v2

source "drivers/staging/nanohub/factory/Kconfig"
```

## drivers/vibrator/zinitix/ztm730/Kconfig
```kconfig
#
# motor drivers configuration
#

config VIB_DRV_ZTM730
	tristate "ZTM730 motor"
	default n
	depends on I2C
	help
	 Say Y to enable the ztm730 motor driver
```

## drivers/video/fbdev/exynos/Kconfig
```kconfig
if SOC_S5E5515

source "drivers/video/fbdev/exynos/dpu30/Kconfig"

endif # SOC_S5E5515
```

## drivers/video/fbdev/samsung/panel/lx8380x/Kconfig
```kconfig
menuconfig USDM_PANEL_LX8380X
	tristate "LX83805/6 DDI Panel Driver"
	depends on USDM_PANEL
	depends on USDM_PANEL_OLED_COMMON
	default n
	help
		This enables LX8380X DDI dependent panel drivers of
		common panel driver. say Y, if you have a panel based on
		the LX8380X DDI.

config USDM_PANEL_FRESH
	bool "watch6 fresh"
	depends on USDM_PANEL_LX8380X
	default n

config USDM_PANEL_WISE
	bool "watch6 wise"
	depends on USDM_PANEL_LX8380X
	default n


########## FOR KUNIT ##########

config LX8380X_TEST
	bool "KUnit test for lx83805 and lx83806 ddi driver"
	depends on SEC_KUNIT
	help
	  TODO: Describe config fully.



########## FOR KUNIT ##########

config LX83805_WATCH6_LARGE_TEST
	bool "KUnit test for tft_common ddi driver"
	depends on SEC_KUNIT
	help
	  TODO: Describe config fully.



########## FOR KUNIT ##########

config LX83806_WATCH6_LARGE_TEST
	bool "KUnit test for tft_common ddi driver"
	depends on SEC_KUNIT
	help
	  TODO: Describe config fully.
```
