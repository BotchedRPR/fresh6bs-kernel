## drivers/battery/Kconfig
```kconfig
menu "Samsung Battery drivers"

source "drivers/battery/core/Kconfig"
source "drivers/battery/control/Kconfig"
source "drivers/battery/module/Kconfig"
source "drivers/battery/fuelgauge/Kconfig"
source "drivers/battery/charger/Kconfig"
source "drivers/battery/wireless/Kconfig"
source "drivers/battery/common/Kconfig"

endmenu
```

## drivers/battery/charger/Kconfig
```kconfig
# SPDX-License-Identifier: GPL-2.0-only

if BATTERY_SAMSUNG

source "drivers/battery/charger/s2mpw03/Kconfig"

endif # BATTERY_SAMSUNG
```

## drivers/battery/charger/s2mpw03/Kconfig
```kconfig
# SPDX-License-Identifier: GPL-2.0-only

config MUIC_S2MPW03
	tristate "S2MPW03 MUIC feature"
	default n
	depends on CHARGER_S2MPW03
	depends on MUIC_NOTIFIER
	help
	  Say Y to include support
	  for S2MPW03 charger RID detection feature.
	  This feature replace MUIC fuctionality.
```

## drivers/battery/common/Kconfig
```kconfig
# SPDX-License-Identifier: GPL-2.0-only

config BATTERY_SAMSUNG
	tristate "samsung battery driver"
	default n
	help
	  Say Y to include support for samsung battery driver
	  This battery driver integrated all battery-related functions
	  To see battery-related functions,
	  refer to sec_charging_common.h

config ENG_BATTERY_CONCEPT
	bool "enable temp block"
	default n
	help
	  Say Y here to enable
	  support CONFIG_ENG_BATTERY_CONCEPT.
	  It is for only in ENG bianry
	  USER binary should disalbe this.
```

## drivers/battery/control/Kconfig
```kconfig
# SPDX-License-Identifier: GPL-2.0-only

config SB_CONTROL
	tristate "sb-ctrl"
	default n
	depends on SB_VOTE
	help
		Say Y here to enable.
		support for sec battery control API.
		refer to API headers.

if SB_CONTROL

source "drivers/battery/control/step/Kconfig"
source "drivers/battery/control/temp/Kconfig"

endif # SB_CONTROL
```

## drivers/battery/control/step/Kconfig
```kconfig
# SPDX-License-Identifier: GPL-2.0-only

config SB_STEP
	tristate "sb-step"
	default n
	help
		Say Y here to enable.
		support for sec battery control-step API.
		refer to API headers.

config SB_STEP_WATCH5
	tristate "sb-step-watch5"
	default n
	help
		Say Y here to enable.
		support for sec battery control-step-watch5 API.
		refer to API headers.

config SB_STEP_WATCH6
	tristate "sb-step-watch6"
	default n
	help
		Say Y here to enable.
		support for sec battery control-step-watch6 API.
		refer to API headers.
```

## drivers/battery/control/temp/Kconfig
```kconfig
# SPDX-License-Identifier: GPL-2.0-only

config SB_TEMP
	tristate "sb-temp"
	default n
	depends on SB_ADC
	help
		Say Y here to enable.
		support for sec battery control-temp API.
		refer to API headers.

config SB_FORCED_EPT
	tristate "sb-forced-ept"
	default n
	depends on SB_ADC
	help
		Say Y here to enable.
		support for sec battery control-forced ept API.
		Refer to API headers.

config SB_TEMP_W6
	tristate "sb-temp-w6"
	default n
	depends on SB_ADC
	help
		Say Y here to enable
		support for sec battery control-temp API for
		Watch 6.
		Refer to API headers.
```

## drivers/battery/core/Kconfig
```kconfig
# SPDX-License-Identifier: GPL-2.0-only

config SB_CORE
	tristate "sb-core"
	default n
	help
	  Say Y here to enable.
	  support for sec battery core API.
	  (module: pq/notify/sysfs/vote)
	  refer to API headers.

config SB_PQUEUE
	bool "sb-pqueue"
	default n
	help
	  Say Y here to enable.
	  support for priority queue.
	  (api: push/pop/remove)
	  If you use the data type,
	  you should set the compare function.
	  refer to sb_pqueue.h

config SB_NOTIFY
	bool "sb-notify"
	default n
	depends on SB_PQUEUE
	help
	  Say Y here to enable.
	  support for notifier.
	  (type: probe/exit/external/others event)
	  refer to sb_notify.h

config SB_SYSFS
	bool "sb-sysfs"
	default n
	depends on SYSFS && POWER_SUPPLY
	help
	  Say Y here to enable.
	  support for common sysfs.
	  If you want to make sysfs node in battery folder,
	  please use this API to work.
	  refer to sb_sysfs.h

config SB_MISC
	bool "sb-misc"
	default n
	help
	  Say Y here to enable.
	  support for miscdevice(ioctl).
	  (api: read/write)
	  refer to sb_misc.h

config SB_VOTE
	bool "sb-vote"
	default n
	depends on SB_PQUEUE
	help
	  Say Y here to enable.
	  support for vote.
	  (set/get/find)
	  refer to sb_voter.h
```

## drivers/battery/fuelgauge/Kconfig
```kconfig
# SPDX-License-Identifier: GPL-2.0-only

if BATTERY_SAMSUNG

source "drivers/battery/fuelgauge/s2mpw03/Kconfig"

endif # BATTERY_SAMSUNG
```

## drivers/battery/fuelgauge/s2mpw03/Kconfig
```kconfig
# SPDX-License-Identifier: GPL-2.0-only

config UI_SOC_PROLONGING
	bool "Ui Soc 100% Prolonging"
	default n
	help
	  Say Y here to enable
	  Support for UI Soc prolonging.
	  This is to enable UI Soc prolonging concept.
```

## drivers/battery/module/Kconfig
```kconfig
# SPDX-License-Identifier: GPL-2.0-only

config SB_MODULE
	tristate "sb-module"
	default n
	help
		Say Y here to enable.
		support for sec battery module API.
		refer to API headers.

if SB_MODULE

source "drivers/battery/module/adc/Kconfig"
source "drivers/battery/module/cisd/Kconfig"
source "drivers/battery/module/work/Kconfig"
source "drivers/battery/module/startup/Kconfig"

endif # SB_MODULE
```

## drivers/battery/module/adc/Kconfig
```kconfig
# SPDX-License-Identifier: GPL-2.0-only

config SB_ADC
	tristate "Samsung Battery ADC"
	default n
	depends on IIO
	help
	  Say Y to use ADC api.
```

## drivers/battery/module/cisd/Kconfig
```kconfig
# SPDX-License-Identifier: GPL-2.0-only

config SB_CISD
	tristate "support for cisd"
	default n
	help
	 Say Y to include support for cisd
	 cisd means cell internal short detection
```

## drivers/battery/module/startup/Kconfig
```kconfig
# SPDX-License-Identifier: GPL-2.0-only

config SB_STARTUP
	tristate "support for startup"
	default n
	depends on SB_PQUEUE
	help
	 Say Y to include support for startup
```

## drivers/battery/module/work/Kconfig
```kconfig
# SPDX-License-Identifier: GPL-2.0-only

config SB_WORK
	tristate "support for work"
	default n
	depends on PM_SLEEP
	help
	 Say Y to include support for work
```

## drivers/battery/wireless/Kconfig
```kconfig
# SPDX-License-Identifier: GPL-2.0-only

config SB_WRL
	tristate "sb-wrl"
	default n
	help
	  Say Y here to enable.
	  support for sec battery wrl API.
	  (module: wrl)
	  refer to API headers.

if BATTERY_SAMSUNG

source "drivers/battery/wireless/p9222/Kconfig"
source "drivers/battery/wireless/cps4019/Kconfig"

endif # BATTERY_SAMSUNG
```

## drivers/battery/wireless/cps4019/Kconfig
```kconfig
# SPDX-License-Identifier: GPL-2.0-only

config WIRELESS_CPS4019
	tristate "CPS4019 wireless charger driver"
	default n
	depends on BATTERY_SAMSUNG && I2C
	help
		Say Y to enable support for CPS wireless charger.
		cps4019 wireless charger driver.
```

## drivers/battery/wireless/p9222/Kconfig
```kconfig
# SPDX-License-Identifier: GPL-2.0-only

config WIRELESS_P9222
	tristate "P9222 battery charger support"
	default n
	depends on BATTERY_SAMSUNG && I2C
	help
		Say Y here to enable support for the p9222 charger
		p9222 wireless charger driver.
```

## drivers/misc/uart_sel/Kconfig
```kconfig
#
# UART_SWITCH Device Driver
#

config UART_SEL
     tristate "UART SWITCH Support"
     default n
	 help
	   This enables UART_SEL driver to control the UART_SEL Device.
```

## drivers/samsung/Kconfig
```kconfig
# drivers/samsung/debug/Kconfig
#
# Copyright (c) 2010-2020 Samsung Electronics Co., Ltd.
#               http://www.samsung.com/
#
# Licensed under GPLv2

menu "Samsung TN Extension Feature"
config SEC_EXT
	bool "Samsung TN extension Feature"
	default y

menuconfig SEC_DEBUG
	tristate "Enable Samsung Debugging features"
	default n

config SEC_REBOOT
	tristate "Enable TN reboot features"
	default n
	help
	  Samsung TN reboot extension Feature. Do additional work when reboot.

config SEC_KEY_NOTIFIER
	tristate "Enable Samsung key event notifier"
	default n
	help
	  Samsung Key input event notifier

config SEC_BOOTSTAT
	tristate "Enable TN Bootstat logging"
	depends on SEC_EXT
	default n
	help
	  This adds support for Samsung boot-stat
	  To compile this driver as a module, choose M here.

config DRV_SAMSUNG
	tristate "Samsung sec class/sysfs Feature"
	depends on SEC_EXT
	default n
	help
	  Samsung sysfs name 'sec' directory create.

comment "Samsung TN Build Options"
config SEC_FACTORY
	bool "SAMSUNG Factory build option"
	depends on SEC_EXT
	default n
	help
	  Include some codes for Factory binary.
	  This option is enabled by Factory build option.
	  In samsung build script, '-F' enables this option.

config SAMSUNG_PRODUCT_SHIP
	bool "set up for product shipping"
	depends on SEC_EXT
	default n
	help
	  This option is enabled by SHIP build option.
	  In samsung build script, '-s' enables this option.
	  
endmenu
source "drivers/samsung/misc/Kconfig"
source "drivers/samsung/pm/Kconfig"
```
